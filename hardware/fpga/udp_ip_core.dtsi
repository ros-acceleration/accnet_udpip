/dts-v1/;

/ {

        fragment@0 {
                target = <0xffffffff>;

                __overlay__ {
                        #address-cells = <0x02>;
                        #size-cells = <0x02>;
                        firmware-name = ".bin";
                        pid = <0x00>;
                        resets = <0xffffffff 0x74>;
                        uid = <0x00>;
                        phandle = <0x02>;
                };
        };

        fragment@1 {
                target = <0xffffffff>;

                __overlay__ {
                        phandle = <0x03>;

                        afi0 {
                                compatible = "xlnx,afi-fpga";
                                config-afi = <0x00 0x00 0x01 0x00 0x02 0x00 0x03 0x00 0x04 0x00 0x05 0x00 0x06 0x00 0x07 0x00 0x08 0x00 0x09 0x00 0x0a 0x00 0x0b 0x00 0x0c 0x00 0x0d 0x00 0x0e 0x800 0x0f 0x00>;
                                phandle = <0x04>;
                        };

                        clocking0 {
                                #clock-cells = <0x00>;
                                assigned-clock-rates = <0x11e19751>;
                                assigned-clocks = <0xffffffff 0x47>;
                                clock-output-names = "fabric_clk";
                                clocks = <0xffffffff 0x47>;
                                compatible = "xlnx,fclk";
                                phandle = <0x05>;
                        };
                };
        };

        fragment@2 {
                target = <0xffffffff>;

                __overlay__ {
                        #address-cells = <0x02>;
                        #size-cells = <0x02>;
                        phandle = <0x06>;

                        fpga@a0010000 {
                                clock-names = "fpga_core_axi_aclk\0fpga_core_axil_aclk";
                                clocks = <0x01 0x01>;
                                compatible = "accelerat,udp-core";
                                reg = <0x00 0xa0010000 0x00 0x10000>;
                                interrupt-parent = <0xffffffff>;
                                interrupts = <0x00 0x59 0x04>;
                                phandle = <0x07>;
                        };

                        misc_clk_0 {
                                #clock-cells = <0x00>;
                                clock-frequency = <0x9502f90>;
                                compatible = "fixed-clock";
                                phandle = <0x01>;
                        };

                        zyxclmm_drm {
                                compatible = "xlnx,zocl";
                        };
                };
        };

        __symbols__ {
                overlay0 = "/fragment@0/__overlay__";
                overlay1 = "/fragment@1/__overlay__";
                afi0 = "/fragment@1/__overlay__/afi0";
                clocking0 = "/fragment@1/__overlay__/clocking0";
                overlay2 = "/fragment@2/__overlay__";
                fpga_inst = "/fragment@2/__overlay__/fpga@a0010000";
                misc_clk_0 = "/fragment@2/__overlay__/misc_clk_0";
        };

        __fixups__ {
                fpga_full = "/fragment@0:target:0";
                zynqmp_reset = "/fragment@0/__overlay__:resets:0";
                amba = "/fragment@1:target:0\0/fragment@2:target:0";
                zynqmp_clk = "/fragment@1/__overlay__/clocking0:assigned-clocks:0\0/fragment@1/__overlay__/clocking0:clocks:0";
                gic = "/fragment@2/__overlay__/fpga@a0010000:interrupt-parent:0";
        };

        __local_fixups__ {

                fragment@2 {

                        __overlay__ {

                                fpga@a0010000 {
                                        clocks = <0x00 0x04>;
                                };
                        };
                };
        };
};